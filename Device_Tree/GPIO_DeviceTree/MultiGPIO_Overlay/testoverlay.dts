/dts-v1/;
/plugin/;
/*
LED1  ---------------------- GPIO0_30       GPIO_30
LED2  ---------------------- GPIO0_31       GPIO_31
LED3  ---------------------- GPIO1_16       GPIO_48
LED4  ---------------------- GPIO0_05       GPIO_05
LED5  ---------------------- GPIO0_03       GPIO_03
*/

// &i2c1 {
//     status = "disabled";
// };

// &spi0 {
//     status = "disabled";
// };

// &uart4 {
//     status = "disabled";
// };

// &uart2 {
//     status = "disabled";
// };

/{
    compatible = "ti,am335x";
    fragment@1 {
        target-path = "/";
        __overlay__ {
            MyGPIOCluster {
                compatible = "QuangNM13,MultiGPIO";
                author = "QuangNM13";
                status = "okay";
                gpio_pin-gpio = <&gpio0 30 0>,
                                <&gpio0 31 0>,
                                <&gpio1 16 0>,
                                <&gpio0 5 0>,
                                <&gpio0 3 0>;
                // pinctrl-names = "default", "gpio";
		        // pinctrl-0 = <&P9_11_default_pin>,
                //             <&P9_13_default_pin>,
                //             <&P9_15_default_pin>,
                //             <&P9_17_default_pin>,
                //             <&P9_21_default_pin>;
		        // pinctrl-1 = <&P9_11_gpio_pin>,
                //             <&P9_13_gpio_pin>,
                //             <&P9_15_gpio_pin>,
                //             <&P9_17_gpio_pin>,
                //             <&P9_21_gpio_pin>;
            };
        }; 
    };
};