/dts-v1/;
/plugin/;
/{
    compatible = "ti,am335x";
    fragment@0 {
        target-path = "/";
        __overlay__ {
            MyDeviceTreeOverlay {
                compatible = "BRIGHTLIGHT";
                status = "okay";
                label = "test";
                my_value = <10000>;
                my_abc = <999>;
                author = "QuangNM13";
            };
        };
    };
};