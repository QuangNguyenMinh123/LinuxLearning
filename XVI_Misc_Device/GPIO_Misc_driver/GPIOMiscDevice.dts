/dts-v1/;
/plugin/;

/{
    compatible = "ti,am33xx";
    fragment@0 {
            target = <&am33xx_pinmux>;
            __overlay__ {
                default_setting: default_setting {
                    pinctrl-single,pins = <
                        0x48  (0 | 1 << 8 | 7)          /* P9_14 GPIO_50 */
                    >;
                };
            };
    };

    fragment@1 {
        target-path = "/";
        __overlay__ {
            GPIOMiscDevice: GPIOMiscDevice {
                compatible = "GPIOMiscDevice";
                author = "QuangNM13";
                status = "okay";
                arbitrary = "12345";
                pin-gpios = <&gpio1 18 0>;
                pinctrl-names = "default";
		        pinctrl-0 = <&default_setting>;
            };
        };
    };
};