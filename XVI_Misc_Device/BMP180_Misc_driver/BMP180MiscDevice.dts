/dts-v1/;
/plugin/;

/{
    compatible = "ti,am33xx";
    fragment@0 {
        target = <&i2c2>;
        __overlay__ {
            status = "okay";
            BMP180Misc: BMP180Misc@77 {
                compatible = "BMP180MiscDevice";
                // author = "QuangNM13";
                // reg = <0x77>;
                // status = "okay";
                // arbitrary = "12345";
            };
        };
    };
};